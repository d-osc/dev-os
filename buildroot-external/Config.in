## buildroot-external/Config.in
```kconfig
menu "Dev OS"
source "$BR2_EXTERNAL_DEVOS_PATH/package/python-securesystemslib/Config.in"
source "$BR2_EXTERNAL_DEVOS_PATH/package/python-tuf/Config.in"
endmenu
```

## buildroot-external/package/python-securesystemslib/Config.in
```kconfig
config BR2_PACKAGE_PYTHON_SECURESYSTEMSLIB
	bool "python-securesystemslib"
	depends on BR2_PACKAGE_PYTHON3
	depends on BR2_PACKAGE_HOST_RUSTC_TARGET_ARCH_SUPPORTS
	select BR2_PACKAGE_PYTHON_CRYPTOGRAPHY
	help
	  Pinned verification runtime for Dev OS package repositories.
```

## buildroot-external/package/python-tuf/Config.in
```kconfig
config BR2_PACKAGE_PYTHON_TUF
	bool "python-tuf"
	depends on BR2_PACKAGE_PYTHON3
	depends on BR2_PACKAGE_HOST_RUSTC_TARGET_ARCH_SUPPORTS
	select BR2_PACKAGE_PYTHON_SECURESYSTEMSLIB
	select BR2_PACKAGE_PYTHON_URLLIB3
	select BR2_PACKAGE_PYTHON_PACKAGING
	select BR2_PACKAGE_PYTHON3_SSL
	select BR2_PACKAGE_PYTHON3_HASHLIB
	select BR2_PACKAGE_CA_CERTIFICATES
	select BR2_PACKAGE_PYTHON_PYELFTOOLS
	help
	  Pinned verification runtime for Dev OS package repositories.
```
